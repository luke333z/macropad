#include <WiFi.h>
#include <BleKeyboard.h>
#include <Adafruit_GFX.h>
#include <Adafruit_ILI9341.h>
#include <SPI.h>
#include <XPT2046_Touchscreen.h>
#include <Wire.h>
#include <RTClib.h>
#include <time.h>
#include <PubSubClient.h>



//bitmaps

const unsigned char skip_bmp[] PROGMEM = {
	0x00, 0x00, 0x00, 0x00, 0x00, 0x00, 0x00, 0x00, 0x00, 0x00, 0x00, 0x00, 0x00, 0x00, 0x00, 0x00, 
	0x00, 0x00, 0x00, 0x00, 0x00, 0x00, 0x00, 0x00, 0x00, 0x00, 0x00, 0x00, 0x00, 0x00, 0x00, 0x00, 
	0x00, 0x00, 0x00, 0x00, 0x00, 0x00, 0x00, 0x00, 0x00, 0x00, 0x00, 0x00, 0x00, 0x00, 0x00, 0x00, 
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	0x00, 0x00, 0x00, 0x00, 0x00, 0x00, 0x00, 0x00, 0x00, 0x00, 0x00, 0x00, 0x00, 0x00
};

const unsigned char rewind_bmp[] PROGMEM = {
	0x00, 0x00, 0x00, 0x00, 0x00, 0x00, 0x00, 0x00, 0x00, 0x00, 0x00, 0x00, 0x00, 0x00, 0x00, 0x00, 
	0x00, 0x00, 0x00, 0x00, 0x00, 0x00, 0x00, 0x00, 0x00, 0x00, 0x00, 0x00, 0x00, 0x00, 0x00, 0x00, 
	0x00, 0x00, 0x00, 0x00, 0x00, 0x00, 0x00, 0x00, 0x00, 0x00, 0x00, 0x00, 0x00, 0x00, 0x00, 0x00, 
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	0x00, 0x00, 0x00, 0x00, 0x00, 0x00, 0x00, 0x00, 0x00, 0x00, 0x00, 0x00, 0x00, 0x00
};

const unsigned char play_bmp[] PROGMEM = {
	0x00, 0x00, 0x00, 0x00, 0x00, 0x00, 0x00, 0x00, 0x00, 0x00, 0x00, 0x00, 0x00, 0x00, 0x00, 0x00, 
	0x00, 0x00, 0x00, 0x00, 0x00, 0x00, 0x00, 0x00, 0x00, 0x00, 0x00, 0x00, 0x00, 0x00, 0x00, 0x00, 
	0x00, 0x00, 0x00, 0x00, 0x00, 0x00, 0x00, 0x00, 0x00, 0x00, 0x00, 0x30, 0x00, 0x00, 0x00, 0x00, 
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	0x00, 0x00, 0x00, 0x00, 0x00, 0x00, 0x00, 0x00, 0x00, 0x00, 0x00, 0x00, 0x00, 0x00
};

const unsigned char pause_bmp[] PROGMEM = {
	0x00, 0x00, 0x00, 0x00, 0x00, 0x00, 0x00, 0x00, 0x00, 0x00, 0x00, 0x00, 0x00, 0x00, 0x00, 0x00, 
	0x00, 0x00, 0x00, 0x00, 0x00, 0x00, 0x00, 0x00, 0x00, 0x00, 0x00, 0x00, 0x00, 0x00, 0x00, 0x00, 
	0x00, 0x00, 0x00, 0x00, 0x00, 0x00, 0x00, 0x00, 0x00, 0x00, 0x00, 0x00, 0x00, 0x00, 0x00, 0x00, 
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	0x00, 0x00, 0x00, 0x00, 0x00, 0x00, 0x00, 0x00, 0x00, 0x00, 0x00, 0x00, 0x00, 0x00
};

const uint16_t placeholder [] PROGMEM = {
	0x2945, 0x2945, 0x2945, 0x2945, 0x2945, 0x2945, 0x2945, 0x2945, 0x2945, 0x2945, 0x2945, 0x2945, 0x2945, 0x2945, 0x2945, 0x2945, 
	0x2945, 0x2945, 0x2945, 0x2945, 0x2945, 0x2945, 0x2945, 0x2945, 0x2945, 0x2945, 0x2945, 0x2945, 0x2945, 0x2945, 0x2945, 0x2945, 
	0x2945, 0x2945, 0x2945, 0x2945, 0x2945, 0x2945, 0x2945, 0x2945, 0x2945, 0x2945, 0x2945, 0x2945, 0x2945, 0x2945, 0x2945, 0x2945, 
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	0x2945, 0x2945, 0x2945, 0x2945, 0x2945, 0x2945, 0x2945, 0x2945, 0x2945, 0x2945, 0x2945, 0x2945, 0x2945, 0x2945, 0x2945, 0x2945
};

// 'volume2', 32x32px
const uint16_t volume2 [] PROGMEM = {
	0x0000, 0x0000, 0x0000, 0x0000, 0x0000, 0x0000, 0x0000, 0x0000, 0x0000, 0x0000, 0x0020, 0x01e3, 0x0407, 0x0529, 0x05ca, 0x066b, 
	0x066b, 0x05ca, 0x0529, 0x0407, 0x01e3, 0x0020, 0x0000, 0x0000, 0x0000, 0x0000, 0x0000, 0x0000, 0x0000, 0x0000, 0x0000, 0x0000, 
	0x0000, 0x0000, 0x0000, 0x0000, 0x0000, 0x0000, 0x0000, 0x0000, 0x00a1, 0x0407, 0x066b, 0x06cb, 0x06cb, 0x06cb, 0x06cb, 0x06cb, 
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	0x066b, 0x05ca, 0x0529, 0x0407, 0x01e3, 0x0020, 0x0000, 0x0000, 0x0000, 0x0000, 0x0000, 0x0000, 0x0000, 0x0000, 0x0000, 0x0000
};
// 'volume4', 32x32px
const uint16_t volume4 [] PROGMEM = {
	0x0000, 0x0000, 0x0000, 0x0000, 0x0000, 0x0000, 0x0000, 0x0000, 0x0000, 0x0000, 0x0000, 0x0000, 0x0000, 0x0000, 0x0000, 0x0000, 
	0x0000, 0xce59, 0xffff, 0xffff, 0xffff, 0xffdf, 0x630c, 0x0000, 0x0000, 0x0000, 0x0000, 0x0000, 0x0000, 0x0000, 0x0000, 0x0000, 
	0x0000, 0x0000, 0x0000, 0x0000, 0x0000, 0x0000, 0x0000, 0x0000, 0x0000, 0x0000, 0x0000, 0x0000, 0x0000, 0x0000, 0x0000, 0x0000, 
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	0x0000, 0xce79, 0xffff, 0xffff, 0xffff, 0xffdf, 0x5aeb, 0x0000, 0x4a49, 0xffdf, 0xffff, 0xffff, 0xffff, 0xdedb, 0x0841, 0x0000
};
// 'volume3', 32x32px
const uint16_t volume3 [] PROGMEM = {
	0x0000, 0x0000, 0x0000, 0x0000, 0x0000, 0x0000, 0x0000, 0x0000, 0x0000, 0x0000, 0x0000, 0x0000, 0x0000, 0x0000, 0x0000, 0x0000, 
	0x0000, 0x0000, 0x0000, 0x0000, 0x0000, 0x0000, 0x0000, 0x0000, 0x0000, 0x0000, 0x0000, 0x0000, 0x0000, 0x0000, 0x0000, 0x0000, 
	0x0000, 0x0000, 0x0000, 0x0000, 0x0000, 0x0000, 0x0000, 0x0000, 0x0000, 0x0000, 0x0000, 0x0000, 0x0000, 0x0000, 0x0000, 0x0000, 
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	0x0000, 0x0000, 0x0000, 0x0000, 0x0000, 0x0000, 0x0000, 0x0000, 0x0000, 0x0000, 0x0000, 0x0000, 0x0000, 0x0000, 0x0000, 0x0000
};
// 'volume0', 32x32px
const uint16_t volume0 [] PROGMEM = {
	0x2965, 0xce79, 0xffff, 0xffff, 0xffff, 0xffff, 0xffff, 0xffff, 0xffff, 0xffff, 0xffff, 0xffff, 0xffff, 0xffff, 0xffff, 0xffff, 
	0xffff, 0xffff, 0xffff, 0xffff, 0xffff, 0xffff, 0xffff, 0xffff, 0xffff, 0xffff, 0xffff, 0xffff, 0xffff, 0xffff, 0xce59, 0x2965, 
	0xce59, 0xffff, 0xffff, 0xffff, 0xffff, 0xffff, 0xffff, 0xffff, 0xffff, 0xffff, 0xffff, 0xffff, 0xffff, 0xffff, 0xffff, 0xffff, 
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	0xffff, 0xffff, 0xffff, 0xffff, 0xffff, 0xffff, 0xffff, 0xffff, 0xffff, 0xef7d, 0x2945, 0x0000, 0x0000, 0x0000, 0x0000, 0x0000
};
// 'volume1', 32x32px
const uint16_t volume1 [] PROGMEM = {
	0x0000, 0x0000, 0x0000, 0x0000, 0x0000, 0x0000, 0x0000, 0x0000, 0x0000, 0x0000, 0x0000, 0x0000, 0x0000, 0x0000, 0x0000, 0x0000, 
	0x0000, 0x0000, 0x0000, 0x0000, 0x0000, 0x0000, 0x0000, 0x0000, 0x0000, 0x0000, 0x0000, 0x0000, 0x0000, 0x0000, 0x0000, 0x0000, 
	0x0000, 0x0000, 0x0000, 0x0000, 0x0000, 0x0000, 0x0000, 0x0000, 0x0000, 0x0000, 0x0000, 0x0000, 0x0000, 0x0000, 0x0000, 0x0000, 
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	0x0000, 0x0000, 0x0000, 0x0000, 0x0000, 0x0000, 0x0000, 0x0000, 0x0000, 0x0000, 0x0000, 0x0000, 0x0000, 0x0000, 0x0000, 0x0000
};

const uint16_t* sliderIcons[5] = {
  volume0,
  volume1,
  volume2,
  volume3,
  volume4
};



// ----------------- WIFI -----------------
const char* WIFI_SSID = "sasha";
const char* WIFI_PASS = "pufiness";



// ----------------- MQTT -----------------
const char* MQTT_SERVER   = "homeassistant.local";
const int   MQTT_PORT     = 1883;
const char* MQTT_USER     = "dashboard";
const char* MQTT_PASSWORD = "pufiness";

WiFiClient espClient;
PubSubClient MQTTclient(espClient);

// ----------------- DISPLAY (ILI9341 SPI) -----------------
#define TFT_CS  5
#define TFT_DC  16
#define TFT_RST 17

Adafruit_ILI9341 tft(TFT_CS, TFT_DC, TFT_RST);


// -------- SPOTIFY META --------

#include <WiFiUdp.h>

WiFiUDP mediaUdp;
static const uint16_t MEDIA_PORT = 4210;
static char mediaPacket[256];


char gTitle[320]  = {0};
char gArtist[320] = {0};
char gArtUrl[256] = {0};

volatile bool gPlaying = false;
volatile uint32_t gPosMs = 0;
volatile uint32_t gDurMs = 0;

volatile bool metaDirty = false;   // cere redraw text / bar

#include <WiFiClientSecure.h>
#include <HTTPClient.h>
#include <TJpg_Decoder.h>


// -------- UI CACHE --------
static char lastTitle[320]  = {0};
static char lastArtist[320] = {0};
static uint32_t lastDurMs   = 0;
static uint32_t lastPosMs = 0;
static bool lastPlaying    = false;
static bool progressBgDrawn = false;

#include <U8g2_for_Adafruit_GFX.h>

U8G2_FOR_ADAFRUIT_GFX u8g2;


// -------- META TEXT LAYOUT --------
static const int TITLE_Y  = 200;   // moved UP
static const int TITLE_H  = 24;    // more space
static const int ARTIST_Y = 226;
static const int ARTIST_H = 16;
static const int META_X  = 0;
static const int META_W  = 240;


// TOUCHSCREEN XPT2046
#define TS_CS   14   
#define TS_IRQ  4 

XPT2046_Touchscreen ts(TS_CS, TS_IRQ);

static const int TS_MINX = 250;
static const int TS_MAXX = 3800;
static const int TS_MINY = 200;
static const int TS_MAXY = 3900;


struct TouchPointPx {
  bool pressed;
  int16_t x;
  int16_t y;
};


// ----------------- SLIDERS -----------------
const int NUM_SLIDERS = 5;
const int analogInputs[NUM_SLIDERS] = {32, 36, 39, 35, 33};
int analogSliderValues[NUM_SLIDERS];

struct SliderInfo {
  const char* name;
  uint16_t color;
};

SliderInfo sliders[NUM_SLIDERS] = {
  { "Current",  ILI9341_MAGENTA    },
  { "Zen",        ILI9341_YELLOW },
  { "Spotify",       ILI9341_GREEN },
  { "Discord",     ILI9341_CYAN },
  { "Other",    ILI9341_ORANGE }
};

enum UiMode { UI_MAIN, UI_SLIDER };
UiMode uiMode = UI_MAIN;
static UiMode lastUiMode = UI_MAIN;

int activeSlider = -1;

uint32_t lastSliderActivity = 0;
uint32_t lastAnimMs = 0;

bool sliderUiDrawn = false;

int barLastFilled = -1;
int lastSliderShown = -1;
int sliderDisplay = 0;
int sliderTarget = 0;


// ----------------- ENCODER PINS -----------------
#define ENC_SW  25
#define CLK_PIN 27
#define DT_PIN  26

int CLK_state;
int prev_CLK_state;

#define DIRECTION_CW  0
#define DIRECTION_CCW 1
int direction = DIRECTION_CW;

BleKeyboard bleKeyboard("ESP32 Sliders+Knob", "ESP32-WROOM", 100);

uint32_t bleDisconnectedSince = 0;
bool screenOff = false;

#define BLE_SCREEN_OFF_DELAY_MS 10000  // 10 secunde


static uint8_t lastBtn = HIGH;
static uint32_t lastBtnMs = 0;

// real time clock DS3231
RTC_DS3231 rtc;

struct RTC_Time {
  uint8_t hour;
  uint8_t minute;
  uint8_t second;
  uint8_t day;
  uint8_t month;
  uint16_t year;
};

#define NTP_SERVER "pool.ntp.org"

// Romania TZ (DST auto)
#define TZ_INFO "EET-2EEST,M3.5.0/3,M10.5.0/4"


// MACRO PAD
#define KEYPAD_ADC_PIN 34
#define KEYPAD_SAMPLES 8
#define KEYPAD_DEBOUNCE_MS 40

//setup
#define COL_OK     ILI9341_GREEN
#define COL_FAIL   ILI9341_RED
#define COL_INFO   ILI9341_WHITE
#define COL_WORK   ILI9341_LIGHTGREY

void printDots(uint8_t count = 3, uint16_t delayMs = 200) {
  for (int i = 0; i < count; i++) {
    tft.print(".");
    delay(delayMs);
  }
}

void printStatus(bool ok) {
  if (ok) {
    tft.setTextColor(COL_OK, ILI9341_BLACK);
    tft.println("OK");
  } else {
    tft.setTextColor(COL_FAIL, ILI9341_BLACK);
    tft.println("FAIL");
  }
  tft.setTextColor(COL_INFO, ILI9341_BLACK);
}



// ----------------- SLIDERS -----------------
void updateSliderValues() {
  for (int i = 0; i < NUM_SLIDERS; i++) {
    analogSliderValues[i] = analogRead(analogInputs[i]) / 4;
  }
}

void sendSliderValues() {
  String builtString;

  for (int i = 0; i < NUM_SLIDERS; i++) {
    builtString += String(analogSliderValues[i]);
    if (i < NUM_SLIDERS - 1) {
      builtString += "|";
    }
  }
  Serial.println(builtString);
}
#define SLIDER_DEADBAND 6

int readADC(int pin, int idx) {
  const int N = 7;                 // număr impar
  static int lastOut[NUM_SLIDERS] = {0};
  int buf[N];

  // colectare probe
  for (int i = 0; i < N; i++) {
    buf[i] = analogRead(pin) / 4;  // 0..1023
    delayMicroseconds(80);
  }

  // sortare (N mic, OK)
  for (int i = 0; i < N - 1; i++) {
    for (int j = i + 1; j < N; j++) {
      if (buf[j] < buf[i]) {
        int t = buf[i];
        buf[i] = buf[j];
        buf[j] = t;
      }
    }
  }

  int median = buf[N / 2];

  // hysteresis (anti-jitter)
  if (abs(median - lastOut[idx]) < 6) {
    return lastOut[idx];
  }

  lastOut[idx] = median;
  return median;
}



void updateSlidersAndDetectMove() {
  static int lastStable[NUM_SLIDERS] = {0};
  static uint32_t lastMoveTime[NUM_SLIDERS] = {0};

  for (int i = 0; i < NUM_SLIDERS; i++) {

    int v = readADC(analogInputs[i], i);

    // ignoră zgomot mic
    if (abs(v - lastStable[i]) <= SLIDER_DEADBAND) {
      // slider stabil
      if (uiMode == UI_SLIDER &&
          activeSlider == i &&
          millis() - lastSliderActivity > 1500) {

        uiMode = UI_MAIN;
        sliderUiDrawn = false;
        lastSliderShown = -1;
        barLastFilled = -1;
        drawMainUI();
      }
      continue;
    }

    // MIȘCARE REALĂ
    lastStable[i] = v;
    lastMoveTime[i] = millis();

    activeSlider = i;
    uiMode = UI_SLIDER;
    lastSliderActivity = millis();
    sliderTarget = v;

    analogSliderValues[i] = v;
  }
}






void drawVerticalBarSmooth(
  int x, int y, int w, int h,
  int value, uint16_t color
) {
  value = constrain(value, 0, 1023);

  int filled = map(value, 0, 1023, 0, h);

  if (filled == barLastFilled) return;

  // 🔻 dacă scade → șterge partea DE JOS
  if (filled < barLastFilled && barLastFilled >= 0) {
    tft.fillRect(
      x + 2,
      y + h - barLastFilled,
      w - 4,
      barLastFilled - filled,
      ILI9341_BLACK
    );
  }

  // 🔺 dacă crește → desenează de jos în sus
  if (filled > barLastFilled) {
    tft.fillRect(
      x + 2,
      y + h - filled,
      w - 4,
      filled - barLastFilled,
      color
    );
  }

  barLastFilled = filled;
}




void drawSliderUIStatic(int slider) {
  tft.fillScreen(ILI9341_BLACK);

  // ICON
  tft.drawRGBBitmap(
    (tft.width() - 32) / 2,
    20,
    sliderIcons[slider],
    32,
    32
  );

  // NUME CENTRAT
  tft.setTextSize(2);
  tft.setTextColor(ILI9341_WHITE);
  int16_t x1, y1;
  uint16_t w, h;
  tft.getTextBounds(sliders[slider].name, 0, 60, &x1, &y1, &w, &h);
  tft.setCursor((tft.width() - w) / 2, 60);
  tft.print(sliders[slider].name);

  // CONTUR BAR
  tft.drawRect(180, 110, 26, 140, ILI9341_WHITE);

  barLastFilled = -1;   // ✅ reset DOAR AICI
  sliderUiDrawn = true;
}


void drawPercent(int x, int y, int value) {
  static int lastPct = -1;

  int pct = map(value, 0, 1023, 0, 100);
  pct = constrain(pct, 0, 100);

  if (pct == lastPct) return;
  lastPct = pct;
  if(pct >= 98)
    pct = 100;
  tft.fillRect(x, y, 80, 30, ILI9341_BLACK);

  tft.setTextSize(2);
  tft.setTextColor(ILI9341_WHITE);
  tft.setCursor(x, y);

  char buf[8];
  snprintf(buf, sizeof(buf), "%3d%%", pct);
  tft.print(buf);
}



void drawSliderUIAnimated(int slider) {

  if (slider != lastSliderShown) {
    sliderUiDrawn = false;
    lastSliderShown = slider;
  }

  if (!sliderUiDrawn) {
    drawSliderUIStatic(slider);
    sliderDisplay = sliderTarget;
  }

  uint32_t now = millis();
  if (now - lastAnimMs < 16) return;
  lastAnimMs = now;

  int prev = sliderDisplay;
  sliderDisplay += (sliderTarget - sliderDisplay) / 6;  // easing mai stabil

  if (abs(sliderTarget - sliderDisplay) < 4) {
    sliderDisplay = sliderTarget;
    return;
  }

  if (sliderTarget > 975) sliderTarget = 1023;



  drawVerticalBarSmooth(
    180, 110,
    26, 140,
    sliderDisplay,
    sliders[slider].color
  );

  drawPercent(70, 160, sliderDisplay);
}



// ----------------- ENCODER -----------------
void handleEncoderVolume() {
  CLK_state = digitalRead(CLK_PIN);
  if (CLK_state != prev_CLK_state && CLK_state == HIGH) {
    if (digitalRead(DT_PIN) == HIGH) {
      direction = DIRECTION_CCW;
    } else {
      direction = DIRECTION_CW;
    }

    if (direction == DIRECTION_CW)
      bleKeyboard.write(KEY_MEDIA_VOLUME_UP);
    else
      bleKeyboard.write(KEY_MEDIA_VOLUME_DOWN);
  }
  prev_CLK_state = CLK_state;

}


void handleButtonMute() {
  uint8_t btn = (uint8_t)digitalRead(ENC_SW);
  if (btn != lastBtn && (millis() - lastBtnMs) > 30) {
    lastBtnMs = millis();
    lastBtn = btn;
    if (btn == LOW && bleKeyboard.isConnected()) {
      bleKeyboard.write(KEY_MEDIA_MUTE);
    }
  }
}

// MQTT

bool connectMQTT() {
  if (MQTTclient.connected()) return true;

  MQTTclient.setServer(MQTT_SERVER, MQTT_PORT);

  uint32_t start = millis();
  while (!MQTTclient.connected() && millis() - start < 8000) {
    if (MQTTclient.connect("macro_pad", MQTT_USER, MQTT_PASSWORD)) {

      return true;
    } else {
 
      delay(50);
    }
  }

  return false;
}


void publishKey(int key) {
  char topic[32];
  snprintf(topic, sizeof(topic),
           "dashboard/key%d", key);

  MQTTclient.publish(topic, "PRESS");
}




//TOUCHSCREEN
static TouchPointPx lastTouch = {false, 0, 0};
static uint32_t lastTouchMs = 0;

// Map helper (clamps)
static int16_t mapClamp(int v, int inMin, int inMax, int outMin, int outMax) {
  if (inMin == inMax) return outMin;
  if (v < inMin) v = inMin;
  if (v > inMax) v = inMax;
  long res = (long)(v - inMin) * (outMax - outMin) / (long)(inMax - inMin) + outMin;
  if (res < outMin) res = outMin;
  if (res > outMax) res = outMax;
  return (int16_t)res;
}

//hitbox helper
static bool hit(int16_t x, int16_t y, int16_t rx, int16_t ry, int16_t rw, int16_t rh) {
  return (x >= rx && x < rx + rw && y >= ry && y < ry + rh);
}


// Reads touch and returns screen pixel coords for YOUR current rotation (3)
TouchPointPx handleTouchscreen() {
  TouchPointPx out = {false, 0, 0};

  // optional: if using IRQ pin, you can check digitalRead(TS_IRQ) first
  if (!ts.touched()) {
    lastTouch.pressed = false;
    return out;
  }

  // Read raw point
  TS_Point p = ts.getPoint();   // p.x, p.y, p.z (pressure)
  // Some boards need this after reading touch if share SPI with TFT:
  // pinMode(TS_CS, OUTPUT);

  // Basic debounce / rate limit
  uint32_t now = millis();
  if (now - lastTouchMs < 15) {   // 15ms
    return lastTouch;
  }
  lastTouchMs = now;

  // Convert raw to "unrotated" screen coords (rotation 0 coordinate system)
  int16_t xr = mapClamp(p.x, TS_MINX, TS_MAXX, 0, tft.width() - 1);
  int16_t yr = mapClamp(p.y, TS_MINY, TS_MAXY, 0, tft.height() - 1);

  // Now apply rotation transform
  // Your tft.setRotation(3).
  // For Adafruit_GFX rotations:
  // 0: normal, 1: 90, 2: 180, 3: 270
  // We'll convert from rotation-0 to rotation-3 pixel space.
  int16_t x, y;
  // If your raw mapping matches a different orientation, swap xr/yr or invert one axis.
  // This transform assumes xr,yr correspond to rotation 0.
  x = 240-xr;
  y = yr;

  // Clamp
  if (x < 0) x = 0;
  if (x >= tft.width()) x = tft.width() - 1;
  if (y < 0) y = 0;
  if (y >= tft.height()) y = tft.height() - 1;

  out.pressed = true;
  out.x = x;
  out.y = y;

  // Simple smoothing (optional): average with last point to reduce jitter
  if (lastTouch.pressed) {
    out.x = (out.x + lastTouch.x) / 2;
    out.y = (out.y + lastTouch.y) / 2;
  }

  lastTouch = out;
  return out;
}

// rtc
RTC_Time readRTC() {
  RTC_Time t;

  DateTime now = rtc.now();

  t.hour   = now.hour();
  t.minute = now.minute();
  t.second = now.second();
  t.day    = now.day();
  t.month  = now.month();
  t.year   = now.year();

  return t;
}

void drawTime() {
  static int lastSecond = -1;

  RTC_Time t = readRTC();              
  if (t.second == lastSecond) return;  
  lastSecond = t.second;

  char buf[9];
  snprintf(buf, sizeof(buf), "%02d:%02d:%02d", t.hour, t.minute, t.second);

  tft.setCursor(1, 2);
  tft.setTextSize(1);
  tft.setTextColor(ILI9341_WHITE, ILI9341_BLACK);
  tft.print(buf);
}

bool syncRTCFromNTP() {
  if (WiFi.status() != WL_CONNECTED) {
    return false;
  }

  configTzTime(TZ_INFO, NTP_SERVER);

  struct tm timeinfo;
  if (!getLocalTime(&timeinfo, 10000)) {   // wait up to 10s
    return false;
  }

  DateTime now(
    timeinfo.tm_year + 1900,
    timeinfo.tm_mon + 1,
    timeinfo.tm_mday,
    timeinfo.tm_hour,
    timeinfo.tm_min,
    timeinfo.tm_sec
  );

  rtc.adjust(now);


  return true;
}

// macro pad
int readKeypad3x3() {
  static int lastKey = -1;
  static uint32_t lastChangeMs = 0;

  // --- ADC averaging ---
  uint32_t sum = 0;
  for (int i = 0; i < KEYPAD_SAMPLES; i++) {
    sum += analogRead(KEYPAD_ADC_PIN);
    delayMicroseconds(150);
  }
  int v = sum / KEYPAD_SAMPLES;

  //Serial.println(v);

  // --- no key zone ---
  int key = -1;
  if (v < 200) {
    key = -1;
  }
  else if (v > 3400) key = 2;   // 1k
  else if (v > 3000) key = 1;   // 2.2k
  else if (v > 2600) key = 0;   // 3.3k
  else if (v > 2200) key = 3;   // 4.7k
  else if (v > 2000) key = 4;   // 6.8k
  else if (v > 1700) key = 5;   // 10k
  else if (v > 900) key = 6;   // 22k
  else if (v > 400)  key = 7;   // 47k
  else if (v > 200)  key = 8;   // 65k

  // --- debounce ---
  uint32_t now = millis();
  if (key != lastKey) {
    lastChangeMs = now;
    lastKey = key;
    return -1;   // așteaptă stabilizare
  }

  if (now - lastChangeMs < KEYPAD_DEBOUNCE_MS) {
    return -1;
  }
  //Serial.print(key);
  //Serial.print("with voltage");
 // Serial.println(v);
  return key;
}

void handleKeyboardKey(int key) {
  switch (key) {
    case 0:
      publishKey(key);
      break;

    case 1:
      publishKey(key);
      break;

    case 2:
      publishKey(key);
      break;
      
    case 3:  // Ctrl + Alt + N
      bleKeyboard.press(KEY_LEFT_CTRL);
      bleKeyboard.press(KEY_LEFT_ALT);
      bleKeyboard.press('n');
      delay(10);
      bleKeyboard.releaseAll();
      break;

    case 4:  // Ctrl + Alt + G
      bleKeyboard.press(KEY_LEFT_CTRL);
      bleKeyboard.press(KEY_LEFT_ALT);
      bleKeyboard.press('g');
      delay(10);
      bleKeyboard.releaseAll();
      break;

    default:
      break;
  }
}

void drawMainUI()
{
  tft.fillScreen(ILI9341_BLACK);
  tft.drawRGBBitmap(56, 42, placeholder, 128, 128);
  tft.drawBitmap(95, 242, play_bmp, 50, 50, ILI9341_WHITE);
  tft.drawBitmap(170, 242, skip_bmp, 50, 50, ILI9341_WHITE);
  tft.drawBitmap(20, 242, rewind_bmp, 50, 50, ILI9341_WHITE);
}

void drawProgressBar() {
  if (gDurMs == 0) return;

  const int barX = 20;
  const int barY = 190;
  const int barW = 200;
  const int barH = 9;
  const int r    = barH / 2;
  const int cy   = barY + r;

  int filled = map(gPosMs, 0, gDurMs, 0, barW);
  filled = constrain(filled, 0, barW);

  static int lastFilled = -1;
  static bool lastPlaying = true;

  // -------- BACKGROUND (draw ONCE, perfect pill) --------
  if (!progressBgDrawn) {
    // left cap
    tft.fillCircle(barX + r, cy, r, ILI9341_DARKGREY);
    // body
    tft.fillRect(barX + r, barY, barW - 2 * r, barH, ILI9341_DARKGREY);
    // right cap
    tft.fillCircle(barX + barW - r, cy, r, ILI9341_DARKGREY);

    lastFilled = -1;
    progressBgDrawn = true;
  }

  // nothing changed → nothing to redraw
  if (filled == lastFilled && gPlaying == lastPlaying) return;

  // -------- ERASE OLD FOREGROUND ONLY --------
  if (lastFilled > 0) {
    int eraseW = max(lastFilled - r, 0);
    tft.fillRect(barX + r, barY, eraseW+1, barH, ILI9341_DARKGREY);
    tft.fillCircle(barX + r, cy, r, ILI9341_DARKGREY);
    tft.fillRect(barX + barW - r, barY, barH , barH, ILI9341_BLACK);
    tft.fillCircle(barX + barW - r, cy, r, ILI9341_DARKGREY);

  }

  lastFilled = filled;
  lastPlaying = gPlaying;

  if (filled <= 0) return;

  uint16_t col = gPlaying ? ILI9341_GREEN : ILI9341_LIGHTGREY;

  // -------- FOREGROUND (same geometry as background) --------

  if (filled <= r) {
    // tiny progress → single circle only
    tft.fillCircle(barX + r, cy, filled, col);
    return;
  }

  // left cap
  tft.fillCircle(barX + r, cy, r, col);

  // body
  int bodyW = min(filled - 2 * r, barW - 2 * r);
  if (bodyW > 0) {
    tft.fillRect(barX + r, barY, bodyW, barH, col);
  }

  // right cap (only if not full)
  if (filled < barW) {
    tft.fillCircle(barX + max(filled - r,r), cy, r, col);
  } else {
    // full bar → draw right background cap in foreground color
    tft.fillCircle(barX + barW - r, cy, r, col);
  }
}

//sleep

void handleBleSleep() {
  bool bleConnected = bleKeyboard.isConnected();
  uint32_t now = millis();

  // ---- BLE CONNECTED ----
  if (bleConnected) {
    bleDisconnectedSince = 0;

    if (screenOff) {
      tft.writeCommand(ILI9341_DISPON);
      delay(20);
      drawMainUI();

      screenOff = false;
    }
    return;
  }

  // ---- BLE DISCONNECTED ----
  if (bleDisconnectedSince == 0) {
    bleDisconnectedSince = now;
    return;
  }

  if (now - bleDisconnectedSince >= BLE_SCREEN_OFF_DELAY_MS) {
    if (!screenOff) {

      tft.fillScreen(ILI9341_BLACK);
      tft.writeCommand(ILI9341_DISPOFF);

      screenOff = true;
    }
  }
}

// media transfer
void mediaUdpInit() {
  mediaUdp.begin(MEDIA_PORT);
}

bool mediaReceive() {
  // actualizează doar când ești în UI_MAIN
  if (uiMode != UI_MAIN) return false;

  int len = mediaUdp.parsePacket();
  if (!len) return false;

  int n = mediaUdp.read(mediaPacket, sizeof(mediaPacket) - 1);
  if (n <= 0) return false;
  mediaPacket[n] = 0;

  String s(mediaPacket);

  int p1 = s.indexOf('|');
  int p2 = s.indexOf('|', p1 + 1);
  int p3 = s.indexOf('|', p2 + 1);
  int p4 = s.indexOf('|', p3 + 1);
  int p5 = s.indexOf('|', p4 + 1);

  if (p1 < 0 || p2 < 0 || p3 < 0 || p4 < 0 || p5 < 0) return false;

  String title   = s.substring(0, p1);
  String artist  = s.substring(p1 + 1, p2);
  uint32_t pos   = s.substring(p2 + 1, p3).toInt();
  uint32_t dur   = s.substring(p3 + 1, p4).toInt();
  String artUrl  = s.substring(p4 + 1, p5);
  bool playing   = (s.substring(p5 + 1).toInt() == 1);

  uint32_t newPosMs = pos * 1000;
  uint32_t newDurMs = dur * 1000;

  // ---- TIMING (mereu actualizat) ----
  gPosMs = newPosMs;
  gDurMs = newDurMs;

  // ---- PLAY / PAUSE ----
  bool playChanged = (gPlaying != playing);
  gPlaying = playing;

  // ---- META CHANGE ----
  bool titleChanged  = strcmp(gTitle, title.c_str()) != 0;
  bool artistChanged = strcmp(gArtist, artist.c_str()) != 0;
  bool durChanged    = (newDurMs != lastDurMs);

  if (titleChanged) {
    strncpy(gTitle, title.c_str(), sizeof(gTitle) - 1);
  }

  if (artistChanged) {
    strncpy(gArtist, artist.c_str(), sizeof(gArtist) - 1);
  }

  if (durChanged) {
    lastDurMs = newDurMs;
    progressBgDrawn = false;   // forțează redraw bar
  }

  // ---- ALBUM ART URL ----
  static char lastArtUrl[256] = {0};
  bool artChanged = strcmp(lastArtUrl, artUrl.c_str()) != 0;

  if (artChanged) {
    strncpy(lastArtUrl, artUrl.c_str(), sizeof(lastArtUrl) - 1);
    strncpy(gArtUrl, artUrl.c_str(), sizeof(gArtUrl) - 1);
  }

  // ---- REDRAW DECISION ----
  if (titleChanged || artistChanged || durChanged || playChanged || artChanged) {
    metaDirty = true;
  }

  return true;
}



void drawCenteredText(
  const char* txt,
  int y,
  int h,
  uint16_t color
) {
  tft.fillRect(0, y, 240, h, ILI9341_BLACK);

  u8g2.setForegroundColor(color);
  u8g2.setBackgroundColor(ILI9341_BLACK);

  int16_t tw = u8g2.getUTF8Width(txt);
  int x = (240 - tw) / 2;
  if (x < 2) x = 2;

  int baseline = y + h - 2;
  u8g2.setCursor(x, baseline);
  u8g2.print(txt);
}

bool tftOutput(int16_t x, int16_t y, uint16_t w, uint16_t h, uint16_t* bitmap) {
  Serial.print("JPEG block: ");
  Serial.print(x);
  Serial.print(",");
  Serial.print(y);
  Serial.print(" ");
  Serial.print(w);
  Serial.print("x");
  Serial.println(h);

  tft.drawRGBBitmap(x, y, bitmap, w, h);
  return true;
}


void drawAlbumArt(const char* url) {
  if (!url || url[0] == 0) return;
  if (WiFi.status() != WL_CONNECTED) return;

  Serial.print("Trying art: ");
  Serial.println(url);

  delay(200);   // ⬅️ FOARTE IMPORTANT

  tft.fillRect(56, 42, 128, 128, ILI9341_BLACK);

  JRESULT res = TJpgDec.drawJpg(56, 42, url);

  Serial.print("JPEG result = ");
  Serial.println(res);
}

#include "SPIFFS.h"

#include <HTTPClient.h>

bool downloadAlbumArt(const char* url) {
  if (!url || url[0] == 0) return false;
  if (WiFi.status() != WL_CONNECTED) return false;

  HTTPClient http;
  http.begin(url);
  int code = http.GET();

  if (code != HTTP_CODE_OK) {
    http.end();
    return false;
  }

  File f = SPIFFS.open("/cover.jpg", "w");
  if (!f) {
    http.end();
    return false;
  }

  WiFiClient* stream = http.getStreamPtr();
  uint8_t buf[512];

  while (http.connected()) {
    size_t len = stream->available();
    if (len) {
      int c = stream->readBytes(buf, min(len, sizeof(buf)));
      f.write(buf, c);
    }
    delay(1);
  }

  f.close();
  http.end();
  return true;
}

void drawAlbumArtLocal() {
  if (!SPIFFS.exists("/cover.jpg")) {
    Serial.println("No local cover");
    return;
  }

  tft.fillRect(56, 42, 128, 128, ILI9341_BLACK);
  TJpgDec.drawJpg(56, 42, "/cover.jpg");
}

bool artReady = false;
// ----------------- SETUP -----------------
void setup() {
  uint32_t bootStart = millis();

  Serial.begin(9600);

  // DISPLAY
  tft.begin();
  u8g2.begin(tft);   // attach to Adafruit_GFX
  u8g2.setFont(u8g2_font_unifont_t_latin);

  tft.setRotation(0);
  tft.fillScreen(ILI9341_BLACK);
  tft.setTextSize(1);
  tft.setCursor(0, 0);

  tft.setTextColor(COL_INFO, ILI9341_BLACK);
  tft.println("Dashboard booting...");
  tft.println();

  // TOUCHSCREEN
  tft.print("Touchscreen ");
  tft.setTextColor(COL_WORK, ILI9341_BLACK);
  printDots();
  pinMode(TS_IRQ, INPUT_PULLDOWN);
  ts.begin();
  ts.setRotation(0);
  printStatus(true);

  // SLIDERS
  tft.print("Sliders ");
  tft.setTextColor(COL_WORK, ILI9341_BLACK);
  printDots();
  for (int i = 0; i < NUM_SLIDERS; i++) pinMode(analogInputs[i], INPUT);
  printStatus(true);

  // BLE
  tft.print("BLE keyboard ");
  tft.setTextColor(COL_WORK, ILI9341_BLACK);
  printDots();
  bleKeyboard.begin();
  printStatus(true);

  // WIFI
  tft.print("WiFi ");
  tft.setTextColor(COL_WORK, ILI9341_BLACK);
  WiFi.mode(WIFI_STA);
  WiFi.begin(WIFI_SSID, WIFI_PASS);
  printDots(6, 250);
  bool wifiOK = (WiFi.status() == WL_CONNECTED);
  printStatus(wifiOK);

  if (wifiOK) {
    tft.print("IP: ");
    tft.println(WiFi.localIP());
    mediaUdpInit();
  }

  if (!SPIFFS.begin(true)) {   // true = FORMAT dacă e nevoie
    Serial.println("SPIFFS mount FAILED");
    while (1);
  }

  Serial.println("SPIFFS mounted OK");

  // RTC
  tft.print("RTC ");
  tft.setTextColor(COL_WORK, ILI9341_BLACK);
  printDots();
  Wire.begin();
  rtc.begin();
  bool rtcOK = syncRTCFromNTP();
  printStatus(rtcOK);

  // MQTT
  tft.print("MQTT ");
  tft.setTextColor(COL_WORK, ILI9341_BLACK);
  printDots();
  bool mqttOK = connectMQTT();
  printStatus(mqttOK);

  // ENCODER
  tft.print("Encoder ");
  tft.setTextColor(COL_WORK, ILI9341_BLACK);
  printDots();
  pinMode(CLK_PIN, INPUT);
  pinMode(DT_PIN, INPUT);
  pinMode(ENC_SW, INPUT_PULLUP);
  prev_CLK_state = digitalRead(CLK_PIN);
  printStatus(true);

  // MACRO PAD ADC
  tft.print("Macro keypad ");
  tft.setTextColor(COL_WORK, ILI9341_BLACK);
  printDots();
  analogReadResolution(12);
  analogSetPinAttenuation(KEYPAD_ADC_PIN, ADC_11db);
  printStatus(true);

  // BOOT TIME
  uint32_t bootTime = millis() - bootStart;
  tft.println();
  tft.setTextColor(COL_INFO, ILI9341_BLACK);
  tft.print("Boot time: ");
  tft.print(bootTime);
  tft.println(" ms");


  TJpgDec.setCallback(tftOutput);
  TJpgDec.setSwapBytes(true);
  TJpgDec.setJpgScale(4); // 1=full, 2=1/2, 4=1/4
  


  delay(4500);



  // MAIN UI
  drawMainUI();
}


// ----------------- LOOP -----------------
void loop() {
  // Run encoder first so fast spins still work even if art receive blocks
  handleEncoderVolume();
  handleButtonMute();
  
  handleBleSleep();

  if(screenOff)
    return;

  
  mediaReceive();
  
  if (uiMode == UI_MAIN) {
    if (metaDirty) { /* redraw meta + icon */ }
    drawProgressBar();
  }

   // ---- UI MODE TRANSITION ----
  if (uiMode != lastUiMode) {
    if (uiMode == UI_MAIN) {
      metaDirty = true;
      progressBgDrawn = false;   // ⬅ force bar background redraw ONCE
    }
    lastUiMode = uiMode;
  }



  TouchPointPx tp = handleTouchscreen();
  if(tp.pressed){
    if(uiMode == UI_SLIDER)
    {
      uiMode = UI_MAIN;
      sliderUiDrawn = false;
      lastSliderShown = -1;
      barLastFilled = -1;

      drawMainUI();
    }

    if(uiMode == UI_MAIN)
    {
      if (hit(tp.x, tp.y, 15, 222, 55, 55)) {
        if (bleKeyboard.isConnected()) bleKeyboard.write(KEY_MEDIA_PREVIOUS_TRACK);
      }
      else if (hit(tp.x, tp.y, 80, 222, 55, 55)) {
        if (bleKeyboard.isConnected()) bleKeyboard.write(KEY_MEDIA_PLAY_PAUSE);
      }
      else if (hit(tp.x, tp.y, 175, 222, 55, 55)) {
        if (bleKeyboard.isConnected()) bleKeyboard.write(KEY_MEDIA_NEXT_TRACK);
      }
    }
    delay(500);
  }

  MQTTclient.loop();
  if (!MQTTclient.connected()) connectMQTT();



  if (metaDirty && uiMode == UI_MAIN) {
    metaDirty = false;
    artReady = false;

    if (downloadAlbumArt(gArtUrl)) {
      artReady = true;
    }





    drawCenteredText(gTitle,  TITLE_Y,  TITLE_H,  ILI9341_WHITE);
    drawCenteredText(gArtist, ARTIST_Y, ARTIST_H, ILI9341_LIGHTGREY);

    tft.fillRect(95, 242, 50, 50, ILI9341_BLACK);
    if (gPlaying)
      tft.drawBitmap(95, 242, pause_bmp, 50, 50, ILI9341_WHITE);
    else
      tft.drawBitmap(95, 242, play_bmp, 50, 50, ILI9341_WHITE);
  }
  if (artReady) {
    drawAlbumArtLocal();
    artReady = false;
  }


  drawTime();

  updateSlidersAndDetectMove();

if (uiMode == UI_SLIDER) {
  drawSliderUIAnimated(activeSlider);

  // dacă NU a mai fost mișcare → revine la menu
  if (millis() - lastSliderActivity > 2000) {
    uiMode = UI_MAIN;
    sliderUiDrawn = false;
    lastSliderShown = -1;
    barLastFilled = -1;

    drawMainUI();   // ← menu-ul reapare
  }
}



  int key = readKeypad3x3();
  if (key != -1) 
    handleKeyboardKey(key);
  
 

  static uint32_t lastSend = 0;
  uint32_t now = millis();
  if (now - lastSend >= 50) {
    lastSend = now;
    updateSliderValues();
    //sendSliderValues();
  }

}
